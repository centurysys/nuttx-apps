## BearSSL/Kconfig
```kconfig
#
# For a description of the syntax of this configuration file,
# see the file kconfig-language.txt in the NuttX tools repository.
#

menu "BearSSL"
config BEAR_SSL
	bool "BearSSL TLS library"
	default n

endmenu # BearSSL
```

## centurysys/libs/mount/Kconfig
```kconfig
if ARCH_BOARD_MAS1XX

config CENTURYSYS_LIB_MOUNT
	tristate "filesystem mount/umount Management library"
	default n

endif
```

## centurysys/libs/power/Kconfig
```kconfig
if ARCH_BOARD_MAS1XX

config CENTURYSYS_LIB_POWER
	tristate "Power Management library"
	default n

endif
```

## centurysys/libs/ppp/Kconfig
```kconfig
if ARCH_BOARD_MAS1XX

config CENTURYSYS_LIB_PPP
	tristate "PPPD Management library"
	default n

endif
```

## centurysys/libs/schedule/Kconfig
```kconfig
if ARCH_BOARD_MAS1XX

config CENTURYSYS_LIB_SCHEDULE
	tristate "Calc Schedule library"
	default n

endif
```

## centurysys/lte_ctrl/Kconfig
```kconfig
#
# For a description of the syntax of this configuration file,
# see the file kconfig-language.txt in the NuttX tools repository.
#

if ARCH_BOARD_MAS1XX

config CENTURYSYS_LTE_CTRL
	tristate "\"lte_ctrl\" utility"
	default n
	---help---
		Enable the "LTE Control" utility

endif
```

## centurysys/mobile_watch_nx/Kconfig
```kconfig
#
# For a description of the syntax of this configuration file,
# see the file kconfig-language.txt in the NuttX tools repository.
#

if ARCH_BOARD_MAS1XX

config CENTURYSYS_MOBILE_WATCH_NX
	tristate "\"mobile_watch\" utility"
	default n
	---help---
		Enable the "mobile_watch" utility

endif
```

## centurysys/pparse/Kconfig
```kconfig
#
# For a description of the syntax of this configuration file,
# see the file kconfig-language.txt in the NuttX tools repository.
#

if ARCH_BOARD_MAS1XX

config CENTURYSYS_PPARSE
	tristate "\"partition parser\" utility"
	default n
	---help---
		Enable the "Partition Parser" utility

endif
```

## centurysys/rtcwake/Kconfig
```kconfig
#
# For a description of the syntax of this configuration file,
# see the file kconfig-language.txt in the NuttX tools repository.
#

if ARCH_BOARD_MAS1XX

config CENTURYSYS_RTCWAKE
	tristate "\"rtcwake\" utility"
	default n
	select CENTURYSYS_LIB_SCHEDULE
	---help---
		Enable the "RTC Wakeup" utility

endif
```

## centurysys/shutdown/Kconfig
```kconfig
#
# For a description of the syntax of this configuration file,
# see the file kconfig-language.txt in the NuttX tools repository.
#

if ARCH_BOARD_MAS1XX

config CENTURYSYS_SHUTDOWN
	tristate "\"Shutdown\" utility"
	default n
	select CENTURYSYS_LIB_POWER
	---help---
		Enable the "Shutdown Board" utility

endif
```

## centurysys/timeout/Kconfig
```kconfig
#
# For a description of the syntax of this configuration file,
# see the file kconfig-language.txt in the NuttX tools repository.
#

if ARCH_BOARD_MAS1XX

config CENTURYSYS_TIMEOUT
	tristate "\"Timeout\" utility"
	default n
	select CENTURYSYS_LIB_POWER
	---help---
		Enable the "Timeout and reboot" utility

endif
```

## examples/serial_relay/Kconfig
```kconfig
#
# For a description of the syntax of this configuration file,
# see the file kconfig-language.txt in the NuttX tools repository.
#

config EXAMPLES_SERIAL_RELAY
	bool "serial-relay example"
	default n
	---help---
		Enable serial-relay example
```

## examples/sqlite3/Kconfig
```kconfig
#
# For a description of the syntax of this configuration file,
# see the file kconfig-language.txt in the NuttX tools repository.
#

config EXAMPLES_SQLITE3
	bool "SQLite3 database example"
	default n
	select LIBC_LOCALE
	select LIBSQLITE3

if EXAMPLES_SQLITE3

config EXAMPLES_SQLITE3_PROGNAME
	string "Program name"
	default "sqlite3"

config EXAMPLES_SQLITE3_PRIORITY
	int "SQLite3 task priority"
	default 100

config EXAMPLES_SQLITE3_STACKSIZE
	int "SQLite3 stack size"
	default DEFAULT_TASK_STACKSIZE

endif
```

## examples/xg50_test_leds/Kconfig
```kconfig
#
# For a description of the syntax of this configuration file,
# see the file kconfig-language.txt in the NuttX tools repository.
#

config EXAMPLES_XG50_TEST_LEDS
	bool "XG-50 shipment test (LEDs)"
	default n
	---help---
		Enable XG-50 shipment test (LEDs)
```

## examples/xg50_test_lte/Kconfig
```kconfig
#
# For a description of the syntax of this configuration file,
# see the file kconfig-language.txt in the NuttX tools repository.
#

config EXAMPLES_XG50_TEST_LTE
	bool "XG-50 shipment test (u-blox LTE module)"
	default n
	---help---
		Enable XG-50 shipment test (u-blox LTE module)
```

## interpreters/luamodules/luasqlite3/Kconfig
```kconfig
#
# For a description of the syntax of this configuration file,
# see the file kconfig-language.txt in the NuttX tools repository.
#

config LUA_SQLITE3_MODULE
	bool "Lua SQLite3 module"
	default n
	depends on INTERPRETERS_LUA
	---help---
		LUA file SQLite3 module
```

## system/libsqlite3/Kconfig
```kconfig
#
# For a description of the syntax of this configuration file,
# see the file kconfig-language.txt in the NuttX tools repository.
#

config LIBSQLITE3
	bool "libsqlite3 DBMS Library"
	default n
	---help---
		Enable build for libsqlite3 database Library
```

## xg50/gps_bg96/Kconfig
```kconfig
#
# For a description of the syntax of this configuration file,
# see the file kconfig-language.txt in the NuttX tools repository.
#

config XG50_GPS_BG96
	bool "XG-50: BG96 GPS application"
	default n
```

## xg50/lib/Kconfig
```kconfig
#
# For a description of the syntax of this configuration file,
# see the file kconfig-language.txt in the NuttX tools repository.
#

config XG50_LIBS
	bool "XG-50 libraries"
	default n
	---help---
		Enable the XG-50 libraries

if XG50_LIBS

config XG50_LIBSERIAL
	bool "Serial Port communication library"
	default n
	---help---
		Enable Serial Port communication library

config XG50_LIBADC
	bool "AD Convertor library"
	default n
	---help---
		Enable AD Convertor library

config XG50_MAILBOX
        bool "Mailbox library"
	default n
	---help---
		Enable Mailbox library

config XG50_MEMPOOL
        bool "Mempool library"
	default n
	---help---
		Enable Memory Pool library


endif
```

## xg50/resources/Kconfig
```kconfig
#
# For a description of the syntax of this configuration file,
# see the file kconfig-language.txt in the NuttX tools repository.
#

if CB2XX_LIBS

config CB2XX_RESOURCES
	bool "CB-2XX create resources"
	default n

endif
```
